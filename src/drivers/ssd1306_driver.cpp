#include "ssd1306_driver.h"
#include <stdlib.h>
#include <string.h>

const uint8_t SSD1306Driver::FONT[][5] = {
    {0x00,0x00,0x00,0x00,0x00}, // 0x20 space
    {0x00,0x00,0x5F,0x00,0x00}, // !
    {0x00,0x07,0x00,0x07,0x00}, // "
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    {0x10,0x08,0x08,0x10,0x08}, // ~
};

static const uint8_t INIT_CMDS[] = {
    0xAE,
    0xD5, 0x80,
    0xA8, 0x3F,
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    0xAF,
};

void SSD1306Driver::sendCmd(uint8_t cmd) {
    _wire->beginTransmission(_addr);
    _wire->write((uint8_t)0x00);
    _wire->write(cmd);
    _wire->endTransmission();
}

void SSD1306Driver::sendCmd2(uint8_t cmd, uint8_t arg) {
    _wire->beginTransmission(_addr);
    _wire->write((uint8_t)0x00);
    _wire->write(cmd);
    _wire->write(arg);
    _wire->endTransmission();
}

void SSD1306Driver::init(uint8_t i2c_addr) {
    _addr = i2c_addr;
    delay(10);
    for (uint8_t i = 0; i < sizeof(INIT_CMDS); i++) sendCmd(INIT_CMDS[i]);
    clearBuffer();
    sendBuffer();
}

void SSD1306Driver::clearBuffer() {
    memset(_fb, 0, sizeof(_fb));
}

void SSD1306Driver::sendBuffer() {
    _wire->beginTransmission(_addr);
    _wire->write((uint8_t)0x00);
    _wire->write(0x21); _wire->write(0x00); _wire->write(0x7F);
    _wire->endTransmission();

    _wire->beginTransmission(_addr);
    _wire->write((uint8_t)0x00);
    _wire->write(0x22); _wire->write(0x00); _wire->write(0x07);
    _wire->endTransmission();

    for (uint16_t i = 0; i < 1024; i += 32) {
        _wire->beginTransmission(_addr);
        _wire->write((uint8_t)0x40);
        for (uint8_t j = 0; j < 32; j++) _wire->write(_fb[i + j]);
        _wire->endTransmission();
    }
}

void SSD1306Driver::drawPixel(int16_t x, int16_t y, bool set) {
    if (x < 0 || x > 127 || y < 0 || y > 63) return;
    uint16_t idx = (uint16_t)x + ((uint16_t)(y >> 3) * 128U);
    uint8_t  bit = (uint8_t)(1u << (y & 7));
    if (set) _fb[idx] |=  bit;
    else     _fb[idx] &= (uint8_t)~bit;
}

void SSD1306Driver::drawLine(int16_t x0, int16_t y0, int16_t x1, int16_t y1) {
    int16_t dx  =  (int16_t)abs(x1 - x0);
    int16_t dy  = -(int16_t)abs(y1 - y0);
    int16_t sx  = x0 < x1 ? 1 : -1;
    int16_t sy  = y0 < y1 ? 1 : -1;
    int16_t err = dx + dy;
    while (true) {
        drawPixel(x0, y0);
        if (x0 == x1 && y0 == y1) break;
        int16_t e2 = (int16_t)(2 * err);
        if (e2 >= dy) { if (x0 == x1) break; err += dy; x0 += sx; }
        if (e2 <= dx) { if (y0 == y1) break; err += dx; y0 += sy; }
    }
}

void SSD1306Driver::drawHLine(int16_t x, int16_t y, int16_t w) {
    for (int16_t i = 0; i < w; i++) drawPixel(x + i, y);
}

void SSD1306Driver::drawVLine(int16_t x, int16_t y, int16_t h) {
    for (int16_t i = 0; i < h; i++) drawPixel(x, y + i);
}

void SSD1306Driver::drawRect(int16_t x, int16_t y, int16_t w, int16_t h) {
    drawHLine(x, y, w);
    drawHLine(x, y + h - 1, w);
    drawVLine(x, y, h);
    drawVLine(x + w - 1, y, h);
}

void SSD1306Driver::fillRect(int16_t x, int16_t y, int16_t w, int16_t h, bool set) {
    for (int16_t row = y; row < y + h; row++)
        for (int16_t col = x; col < x + w; col++)
            drawPixel(col, row, set);
}

void SSD1306Driver::drawCircle(int16_t cx, int16_t cy, int16_t r) {
    int16_t x = 0, y = r, d = 1 - r;
    while (x <= y) {
        drawPixel(cx + x, cy + y); drawPixel(cx - x, cy + y);
        drawPixel(cx + x, cy - y); drawPixel(cx - x, cy - y);
        drawPixel(cx + y, cy + x); drawPixel(cx - y, cy + x);
        drawPixel(cx + y, cy - x); drawPixel(cx - y, cy - x);
        if (d < 0) { d += 2 * x + 3; }
        else       { d += 2 * (x - y) + 5; y--; }
        x++;
    }
}

void SSD1306Driver::fillCircle(int16_t cx, int16_t cy, int16_t r) {
    int16_t x = 0, y = r, d = 1 - r;
    while (x <= y) {
        drawHLine(cx - x, cy + y, 2 * x + 1);
        drawHLine(cx - x, cy - y, 2 * x + 1);
        drawHLine(cx - y, cy + x, 2 * y + 1);
        drawHLine(cx - y, cy - x, 2 * y + 1);
        if (d < 0) { d += 2 * x + 3; }
        else       { d += 2 * (x - y) + 5; y--; }
        x++;
    }
}

void SSD1306Driver::printAt(uint8_t px, uint8_t py, const char* str) {
    while (*str) {
        char c = *str++;
        if (c < 0x20 || c > 0x7E) c = ' ';
        const uint8_t* glyph = FONT[(uint8_t)c - 0x20];
        for (uint8_t col = 0; col < 5; col++) {
            uint8_t colData = glyph[col];
            for (uint8_t row = 0; row < 8; row++) {
                if (colData & (1u << row)) drawPixel((int16_t)(px + col), (int16_t)(py + row));
            }
        }
        px += 6;
        if (px > 121) break;
    }
}

void SSD1306Driver::printAt(uint8_t px, uint8_t py, long value) {
    char buf[14];
    bool neg = (value < 0);
    if (neg) value = -value;
    uint8_t i = sizeof(buf) - 1;
    buf[i] = '\0';
    if (value == 0) buf[--i] = '0';
    else { while (value > 0 && i > 0) { buf[--i] = '0' + (uint8_t)(value % 10); value /= 10; } }
    if (neg && i > 0) buf[--i] = '-';
    printAt(px, py, buf + i);
}

void SSD1306Driver::printAt(uint8_t px, uint8_t py, unsigned long value) {
    char buf[12];
    uint8_t i = sizeof(buf) - 1;
    buf[i] = '\0';
    if (value == 0) buf[--i] = '0';
    else { while (value > 0 && i > 0) { buf[--i] = '0' + (uint8_t)(value % 10); value /= 10; } }
    printAt(px, py, buf + i);
}